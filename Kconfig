## Kconfig
```kconfig
# Kconfig file for LAMINPIE

menu "LAMINPIE configuration"

    # Define CONFIG_LAMINPIE__CONF_SKIP so we can use LAMINPIE
    # without laminpie_conf.h file, the product_config.json 
    # will be used instead.
    config LAMINPIE_CONF_SKIP
        bool "Uncheck this to use custom laminpie_conf.h"
        default y

    # config LAMINPIE_CONF_MINIMAL
    #     bool "LAMINPIE minimal configuration."

    menu "Log settings"
        choice LAMINPIE_LOG_LEVEL
            prompt "Log level."
            default LAMINPIE_LOG_LEVEL_INFO
            help
                Log level to be used.

            config LAMINPIE_LOG_LEVEL_DEBUG
                bool "Debug"
            config LAMINPIE_LOG_LEVEL_INFO
                bool "Info"
            config LAMINPIE_LOG_LEVEL_WARN
                bool "Warn"
            config LAMINPIE_LOG_LEVEL_ERROR
                bool "Error"
        endchoice

    endmenu

    menu "LAMINPIE - Core Configurations"
        menuconfig LAMINPIE_ENABLE_LOG
            bool "Log"
            default y
    
        if LAMINPIE_ENABLE_AI_FRAMEWORK
            rsource "src/core/ai_framework/Kconfig"
        endif
    
        menuconfig LAMINPIE_ENABLE_GUI
            bool "GUI"
            default y
    
        if LAMINPIE_ENABLE_GUI
            rsource "src/core/gui/Kconfig"
        endif
    
        menuconfig LAMINPIE_ENABLE_SERVICES
            bool "Services"
            default y
    
        if LAMINPIE_ENABLE_SERVICES
            rsource "src/core/services/Kconfig"
        endif
    
        menuconfig LAMINPIE_ENABLE_SYSTEMS
            bool "Systems"
            default y
    
        if LAMINPIE_ENABLE_SYSTEMS
            rsource "src/core/systems/Kconfig"
        endif

        menuconfig LAMINPIE_ENABLE_DEVICE
            bool "Device"
            default y
    
        if LAMINPIE_ENABLE_DEVICE
            rsource "src/device/Kconfig"
        endif

        menuconfig LAMINPIE_ENABLE_TEST
            bool "Enable LaminPie Test Suite"
            default n
            help
                Enable LaminPie test suite for development and validation.
                This includes unit tests, integration tests, and performance tests.

        if LAMINPIE_ENABLE_TEST
            rsource "test/Kconfig"
        endif
    endmenu

    menu "LAMINPIE - USE OS"

        choice LAMINPIE_USE_OS
            prompt "Use OS"
            default LAMINPIE_USE_OS_STD_THREAD
            help
                Select the operating system for LAMINPIE threading support.
                STD_THREAD uses C++ standard library (default).
                PTHREAD uses POSIX threads.
                FREERTOS uses FreeRTOS.
                RTTHREAD uses RT-Thread.

            config LAMINPIE_USE_OS_NONE
                bool "NONE"
                help
                    No operating system support. Threading functions will be stubs.

            config LAMINPIE_USE_OS_STD_THREAD
                bool "STD_THREAD"
                help
                    Use C++ standard library threading (std::thread, std::mutex, etc.)

            config LAMINPIE_USE_OS_PTHREAD
                bool "PTHREAD"
                help
                    Use POSIX threads (pthread)

            config LAMINPIE_USE_OS_FREERTOS
                bool "FREERTOS"
                help
                    Use FreeRTOS threading

            config LAMINPIE_USE_OS_RTTHREAD
                bool "RTTHREAD"
                help
                    Use RT-Thread threading

            config LAMINPIE_USE_OS_CUSTOM
                bool "CUSTOM"
                help
                    Use custom OS implementation
                    
        endchoice

        # 数值映射
        config LAMINPIE_USE_OS_VALUE
            int
            default 0 if LAMINPIE_USE_OS_NONE
            default 1 if LAMINPIE_USE_OS_STD_THREAD
            default 2 if LAMINPIE_USE_OS_PTHREAD
            default 3 if LAMINPIE_USE_OS_FREERTOS
            default 4 if LAMINPIE_USE_OS_RTTHREAD
            default 5 if LAMINPIE_USE_OS_CUSTOM

        # 自定义操作系统配置
        if LAMINPIE_USE_OS_CUSTOM
            config LAMINPIE_OS_CUSTOM_INCLUDE
                string "Custom OS include file"
                default "my_os_porting.h"
                help
                    Path to the custom OS porting header file
        endif

        # 线程配置
        config LAMINPIE_THREAD_STACK_SIZE_DEFAULT
            int "Default thread stack size"
            default 4096
            help
                Default stack size for threads in bytes

        config LAMINPIE_THREAD_PRIORITY_DEFAULT
            int "Default thread priority"
            default 2
            range 0 4
            help
                Default thread priority (0=lowest, 4=highest)

    endmenu
endmenu
```

## src/core/gui/Kconfig
```kconfig
menuconfig LAMINPIE_GUI_ENABLE_ANIM_PLAYER
    bool "Animation Player"
    default y

if LAMINPIE_GUI_ENABLE_ANIM_PLAYER
    config LAMINPIE_GUI_ANIM_PLAYER_ENABLE_DEBUG_LOG
        bool "Enable debug log output"
        default y
endif # LAMINPIE_GUI_ENABLE_ANIM_PLAYER

menu "LVGL"
    menuconfig LAMINPIE_GUI_LVGL_ENABLE_DEBUG_LOG
        bool "Enable debug log output"
        depends on LAMINPIE_LOG_LEVEL_DEBUG

    if LAMINPIE_GUI_LVGL_ENABLE_DEBUG_LOG
        config LAMINPIE_LVGL_ANIMATION_ENABLE_DEBUG_LOG
            bool "Animation"
            depends on LAMINPIE_LOG_LEVEL_DEBUG
            default y
        
        config LAMINPIE_LVGL_CANVAS_ENABLE_DEBUG_LOG
            bool "Canvas"
            depends on LAMINPIE_LOG_LEVEL_DEBUG
            default y
        
        config LAMINPIE_LVGL_CONTAINER_ENABLE_DEBUG_LOG
            bool "Container"
            depends on LAMINPIE_LOG_LEVEL_DEBUG
            default y
        
        config LAMINPIE_LVGL_DISPLAY_ENABLE_DEBUG_LOG
            bool "Display"
            depends on LAMINPIE_LOG_LEVEL_DEBUG
            default y
        
        config LAMINPIE_LVGL_HELPER_ENABLE_DEBUG_LOG
            bool "Helper"
            depends on LAMINPIE_LOG_LEVEL_DEBUG
            default y

        config LAMINPIE_LVGL_OBJECT_ENABLE_DEBUG_LOG
            bool "Object"
            depends on LAMINPIE_LOG_LEVEL_DEBUG
            default y

        config LAMINPIE_LVGL_SCREEN_ENABLE_DEBUG_LOG
            bool "Screen"
            depends on LAMINPIE_LOG_LEVEL_DEBUG
            default y

        config LAMINPIE_LVGL_TIMER_ENABLE_DEBUG_LOG
            bool "Timer"
            depends on LAMINPIE_LOG_LEVEL_DEBUG
            default y
    endif
endmenu # LVGL

menuconfig LAMINPIE_GUI_ENABLE_SQUARELINE
    bool "Squareline Helpers"
    default y

if LAMINPIE_GUI_ENABLE_SQUARELINE
    config LAMINPIE_SQUARELINE_ENABLE_UI_COMP
        bool "Use UI component from inside"
        default y

    config LAMINPIE_SQUARELINE_ENABLE_UI_HELPERS
        bool "Use UI helpers from inside"
        default y
endif

menu "Style"
    config LAMINPIE_STYLE_ENABLE_DEBUG_LOG
        bool "Enable debug log output"
        depends on LAMINPIE_LOG_LEVEL_DEBUG
        default y
endmenu
```

## src/core/services/Kconfig
```kconfig
menuconfig LAMINPIE_SERVICES_ENABLE_STORAGE
    bool "Storage NVS Services"
    default y

if LAMINPIE_SERVICES_ENABLE_STORAGE
    config LAMINPIE_STORAGE_ENABLE_DEBUG_LOG
        bool "Enable debug log output"
        depends on LAMINPIE_LOG_LEVEL_DEBUG
        default y
endif # LAMINPIE_SERVICES_ENABLE_STORAGE
```

## src/core/systems/Kconfig
```kconfig
menu "Systems"
    menuconfig LAMINPIE_SYSTEM_ENABLE_DEBUG_LOG
        bool "Enable debug log output"
        depends on LAMINPIE_LOG_LEVEL_DEBUG

    if LAMINPIE_SYSTEM_ENABLE_DEBUG_LOG
        config LAMINPIE_SYSTEM_APP_ENABLE_DEBUG_LOG
            bool "App"
            default y

        config LAMINPIE_SYSTEM_EVENT_ENABLE_DEBUG_LOG
            bool "Event"
            default y

        config LAMINPIE_SYSTEM_MANAGER_ENABLE_DEBUG_LOG
            bool "Manager"
            default y

        config LAMINPIE_SYSTEM_CORE_ENABLE_DEBUG_LOG
            bool "Core"
            default y
    endif # LAMINPIE_SYSTEM_ENABLE_DEBUG_LOG
endmenu
```

## src/device/Kconfig
```kconfig
menu "Device configuration"
    if LAMINPIE_ENABLE_DEVICE
        menu "Bus configuration"
            config LAMINPIE_DEVICE_AUTO_INIT_BUS
                bool "Auto initialize bus at system startup"
                default y
                help
                    if enabled, the selected bus will be initialized at system startup

            config LAMINPIE_DEVICE_AUTO_SCAN_BUS
                bool "Auto scan bus"
                default y
                help
                    if enabled, the selected bus will keep scanning for adding devices during system running
                
            if LAMINPIE_DEVICE_AUTO_INIT_BUS
                config LAMINPIE_ENABLE_I2C_BUS
                    bool "Enable I2C bus"
                    default y
                
                config LAMINPIE_ENABLE_SPI_BUS
                    bool "Enable SPI bus"
                    default n
                
                config LAMINPIE_ENABLE_UART_BUS
                    bool "Enable UART bus"
                    default n
            endif

            menu "Device Internal Support Drivers"
                menu "I2C Drivers"
                    config LAMINPIE_ENABLE_SHT30_DRIVER
                        depends on LAMINPIE_ENABLE_I2C_BUS
                        bool "Enable SHT30 temperature & humidity sensor"
                        default n
                    
                    config LAMINPIE_ENABLE_BMP280_DRIVER
                        depends on LAMINPIE_ENABLE_I2C_BUS
                        bool "Enable BMP280 pressure sensor"
                        default n
                endmenu
                
                menu "SPI Drivers"
                    depends on LAMINPIE_ENABLE_SPI_BUS
                    # SPI驱动配置
                endmenu
            endmenu
        endmenu
        menu "Board Support Package (BSP)"
            choice LAMINPIE_BSP_PLATFORM
                prompt "Select BSP platform"
                default LAMINPIE_BSP_PLATFORM_ESP32
                help
                    Select the BSP platform for the device
                config LAMINPIE_BSP_PLATFORM_ESP32
                    bool "ESP32"
                    help
                        ESP32 is a series of low-cost, low-power, and low-complexity microcontrollers designed for IoT applications.
                config LAMINPIE_BSP_PLATFORM_RT_THREAD
                    bool "RT-Thread"
                    help
                        RT-Thread is a real-time operating system for microcontrollers.
            endchoice

            choice LAMINPIE_ESP32_BOARD
                depends on LAMINPIE_BSP_PLATFORM_ESP32
                prompt "Select ESP32 board"
                default LAMINPIE_BSP_PLATFORM_BOARD_ESP32_S3
                help
                    Select the ESP32 board for the device
                config LAMINPIE_BSP_PLATFORM_BOARD_ESP32_S3
                    bool "esp32-s3"
                config LAMINPIE_BSP_PLATFORM_BOARD_ESP32_P4
                    bool "esp32-p4"
            endchoice

            choice LAMINPIE_RT_THREAD_BOARD
                depends on LAMINPIE_BSP_PLATFORM_RT_THREAD
                prompt "Select RT-Thread board"
                default LAMINPIE_BSP_PLATFORM_BOARD_RT_THREAD_SF32
                help
                    Select the RT-Thread board for the device
                config LAMINPIE_BSP_PLATFORM_BOARD_RT_THREAD_SF32
                    bool "sf32"
            endchoice

            if LAMINPIE_BSP_PLATFORM_ESP32
                if LAMINPIE_BSP_PLATFORM_BOARD_ESP32_S3
                    menu "ESP32-S3 Configuration"
                        depends on LAMINPIE_ENABLE_I2C_BUS
                        config LAMINPIE_ESP32_I2C_PORT_SELECT
                            int "I2c port"
                            range 0 1
                            default 0
                            help
                                Select the I2C port to use
                                            
                        config LAMINPIE_ESP32_I2C0_SDA_PIN
                            int "GPIO SDA pin"
                            range 0 48
                            default 21
                        
                        config LAMINPIE_ESP32_I2C0_SCL_PIN
                            int "GPIO SCL pin"
                            range 0 48
                            default 22
                        
                        config LAMINPIE_ESP32_I2C0_FREQ
                            int "I2C frequency (Hz)"
                            range 100000 1000000
                            default 400000
                    endmenu
                endif
            endif
        endmenu

        menu "Device Manager Configuration"
            config LAMINPIE_DEVICE_MAX_COUNT
                int "Maximum number of devices"
                range 1 64
                default 16
            
            config LAMINPIE_DEVICE_EVENT_QUEUE_SIZE
                depends on LAMINPIE_DEVICE_AUTO_SCAN_BUS
                int "Event queue size"
                range 4 128
                default 16
        endmenu        
    endif
endmenu
```

## test/Kconfig
```kconfig
menu "LaminPie Test Configuration"

    # 基础测试开关
    config LAMINPIE_TEST_ENABLE_LOG_SYSTEM
        bool "Enable Log System Tests"
        default y
        help
            Enable unit tests for the log system including log levels,
            module logging, and performance tests.

    config LAMINPIE_TEST_ENABLE_EVENT_SYSTEM
        bool "Enable Event System Tests"
        default y
        help
            Enable integration tests for the event system including
            event registration, dispatch, and async processing.

    config LAMINPIE_TEST_ENABLE_EVENT_STRESS
        bool "Enable Event Stress Tests"
        default n
        help
            Enable stress tests for high-frequency event handling
            and concurrent event processing.

    config LAMINPIE_TEST_ENABLE_APP_SCHEDULER
        bool "Enable App Scheduler Tests"
        default n
        help
            Enable tests for application scheduler including
            app startup, lifecycle, and multiple app management.

    config LAMINPIE_TEST_ENABLE_DEVICE_SYSTEM
        bool "Enable Device System Tests"
        default n
        help
            Enable tests for device management system including
            device registration, discovery, and lifecycle.

    config LAMINPIE_TEST_ENABLE_THREAD_SYSTEM
        bool "Enable Thread System Tests"
        default y
        help
            Enable tests for thread system including thread creation,
            destruction, and priority management.

    config LAMINPIE_TEST_ENABLE_PLATFORM_COMPATIBILITY
        bool "Enable Platform Compatibility Tests"
        default n
        help
            Enable cross-platform compatibility tests for threading,
            logging, and conditional compilation.

    config LAMINPIE_TEST_ENABLE_KCONFIG
        bool "Enable KConfig Tests"
        default n
        help
            Enable tests for KConfig system including configuration
            loading and value validation.

    config LAMINPIE_TEST_ENABLE_MEMORY_PERFORMANCE
        bool "Enable Memory Performance Tests"
        default n
        help
            Enable performance tests for memory allocation speed
            and fragmentation analysis.

endmenu
```
